/*
 * gfx.c
 *
 *  Created on: Apr 11, 2018
 *      Author: max
 */

#include "config.h"

#if defined(GFX_MODULE) && (GFX_MODULE == 1)

#include <stdio.h>
#include <stdint.h>
#include <stdlib.h>
#include <string.h>
#include <alt_types.h>

#include "mb.h"
#include "gfx.h"

#define _swap_int16_t(a,b) {int16_t t=a; a=b; b=t;}

#if defined(GFX_FONTS) && (GFX_FONTS == 1)

typedef struct { // Data stored PER GLYPH
  alt_u16  bitmapOffset;     // Pointer into GFXfont->bitmap
  alt_u8   width, height;    // Bitmap dimensions in pixels
  alt_u8   xAdvance;         // Distance to advance cursor (x axis)
  alt_8    xOffset, yOffset; // Dist from cursor pos to UL corner
} GFXglyph;

typedef struct { // Data stored for FONT AS A WHOLE:
  alt_u8   *bitmap;      // Glyph bitmaps, concatenated
  GFXglyph *glyph;       // Glyph array
  alt_u8    first, last; // ASCII extents
  alt_u8    yAdvance;    // Newline distance (y axis)
} GFXfont;

#include GFX_FONT_FILE
GFXfont *gfxFont = (GFXfont*)&GFX_FONT_NAME;

#endif /* defined(GFX_FONTS) && (GFX_FONTS == 1) */

#if defined(GFX_LOGO) && (GFX_LOGO == 1)
alt_u16 const arduino_bmp[] = {
  0x0000, 0x0000, 0x0FC0, 0x0000, 0x0000, 0x0000, 0x0000, 0x03F0,
  0x0000, 0x0000, 0x0000, 0x0003, 0xFFFF, 0xC000, 0x0000, 0x0000,
  0x0003, 0xFFFF, 0xE000, 0x0000, 0x0000, 0x003F, 0xFFFF, 0xF800,
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  0x0000, 0x0000,
};

GFXbmp const arduinoLogo = {
  0, 160, 110,
  sizeof(arduino_bmp)/sizeof(alt_u16),
  (alt_u16*)arduino_bmp
};
#endif /* defined(GFX_LOGO) && (GFX_LOGO == 1) */

/**
 * local variables
 */
GFXgc gfxDefaultGc = {
  GFX_FB_WIDTH,
  GFX_FB_HEIGHT,
  1,
  16,
  GFX_GC_FMT_ARGB16,
  0,
  0,
  0xffffffff,
  1,
  GFX_FB_BASE
};

GFXgc * gfxGc = &gfxDefaultGc;

/**
 */
void gfxInit(int devs)
{
  memset(GFX_CAM_BASE, 0, GFX_FB_WIDTH*GFX_FB_HEIGHT*2);
  memset(GFX_FB_BASE, 0xFF, GFX_FB_WIDTH*GFX_FB_HEIGHT*2);

#if defined(GFX_LOGO) && (GFX_LOGO == 1)
  drawBmp((GFXbmp*)&arduinoLogo, (640-160)/2, (480-110)/2, 33396);
#endif
}

#if defined(GFX_CMDS) && (GFX_CMDS == 1)
/**
 *
 */
void gfxCmd(void)
{
  alt_u32 volatile *rpc = (alt_u32*)MB_BASE;
  alt_u32 ret;

  ret = -1;
  switch(MB_CMD(rpc[0])){
  case 0:
    ret = writePixel(rpc[1], rpc[2], rpc[3]);
    break;
  case 1:
    ret = writeLine(rpc[1], rpc[2], rpc[3], rpc[4], rpc[5]);
    break;
  case 2:
    ret = drawRect(rpc[1], rpc[2], rpc[3], rpc[4], rpc[5]);
    break;
  case 3:
    ret = fillRect(rpc[1], rpc[2], rpc[3], rpc[4], rpc[5]);
    break;
  case 4:
    ret = drawCircle(rpc[1], rpc[2], rpc[3], rpc[4]);
    break;
  case 5:
    ret = fillCircle(rpc[1], rpc[2], rpc[3], rpc[4]);
    break;
#if defined(GFX_FONTS) && (GFX_FONTS == 1)
  case 6:
    ret = drawChar(rpc[1], rpc[2], rpc[3], rpc[4], rpc[5]);
    break;
  case 7:
    ret = drawTxt(rpc[1], rpc[2], rpc[3], (alt_u8*)rpc[4]);
    break;
  case 8:
    ret = setFont(rpc[1]);
    break;
  case 9:
    ret = setCursor(rpc[1],rpc[2]);
    break;
  case 10:
    ret = setTextSize(rpc[1]);
    break;
  case 11:
    ret = setColor(rpc[1]);
    break;
  case 12:
    ret = setAlpha(rpc[1]);
    break;
  case 13:
    ret = drawCharAtCursor(rpc[1]);
    break;

#endif /* defined(GFX_FONTS) && (GFX_FONTS == 1) */
  }
  rpc[1] = ret;
}
#endif /* defined(GFX_CMDS) && (GFX_CMDS == 1) */

/**
 */
alt_u32 gcSet(GFXgc* pGc)
{
  if (!pGc) {
    gfxGc = &gfxDefaultGc;
  }else{
    gfxGc = pGc;
  }
  return 0;
}

alt_u32 colorFormat(alt_u32 color)
{
  switch (gfxGc->fmt) {
  case GFX_GC_FMT_ARGB16:
    color = ((color&0x000000F8)>>3) |
            ((color&0x0000F800)>>6) | 
            ((color&0x00F80000)>>9) |
            ((color&0x80000000)>>16); 
    break;
  }
  return color;
}
/**
 * Draw a Point of color at x, y
 */
alt_u32 writePixel(alt_u16 x, alt_u16 y, alt_u32 color)
{
  color = colorFormat(color);
  if (gfxGc->flg & GFX_GC_ROT90) {
    alt_u16 t;
    t = x;
    x = y;
    y = t;
  }
  if (x>=gfxGc->width ||
      y>=gfxGc->height)
      return -1;

  if (gfxGc->wp) {
    return gfxGc->wp(x, y, color);
  }

  if (gfxGc->bpp == 16) {
    alt_u16 *p;

    p = (alt_u16*)gfxGc->fb + ((x + y*gfxGc->width) * gfxGc->stride);
    *p = color;
  } else {
    alt_u32 *p;

    p = (alt_u32*)gfxGc->fb + ((x + y*gfxGc->width) * gfxGc->stride);
    *p = color;
  }
  return 0;
}

/**
 */
alt_u32 writeHLine(alt_u16 x, alt_u16 y, alt_u16 l, alt_u32 color)
{
  alt_u32 i;

  for(i=x; i<x+l; i++){
    writePixel(i, y, color);
  }
  return 0;
}

/**
 */
alt_u32 writeVLine(alt_u16 x, alt_u16 y, alt_u16 l, alt_u32 color)
{
  alt_u32 i;

  for(i=y; i<y+l; i++){
    writePixel(x, i, color);
  }
  return 0;
}

/**
 *
 */
alt_u32 writeLine(alt_u16 x0, alt_u16 y0, alt_u16 x1, alt_u16 y1, alt_u32 color)
{
  alt_16 steep = abs(y1 - y0) > abs(x1 - x0);
  alt_16 dx, dy;
  alt_16 err;
  alt_16 ystep;

  if (steep) {
    _swap_int16_t(x0, y0);
    _swap_int16_t(x1, y1);
  }

  if (x0 > x1) {
    _swap_int16_t(x0, x1);
    _swap_int16_t(y0, y1);
  }

  dx = x1 - x0;
  dy = abs(y1 - y0);
  err = dx / 2;

  if(y0<y1){
    ystep = 1;
  } else {
    ystep = -1;
  }

  for(; x0<=x1; x0++){
    if(steep){
      writePixel(y0, x0, color);
    }else{
      writePixel(x0, y0, color);
    }
    err -= dy;
    if(err<0){
      y0 += ystep;
      err += dx;
    }
  }
  return 0;
}

/**
 * Draw a rectangle
 */
alt_u32 drawRect(alt_u16 x, alt_u16 y, alt_u16 w, alt_u16 h, alt_u32 color)
{
  writeHLine(x, y, w, color);
  writeHLine(x, y+h-1, w, color);
  writeVLine(x, y, h, color);
  writeVLine(x+w-1, y, h, color);
  return 0;
}
/**
 */
alt_u32 fillRect(alt_u16 x, alt_u16 y, alt_u16 w, alt_u16 h, alt_u32 color)
{
  alt_u32 i;
  for (i=x; i<x+w; i++) {
    writeVLine(i, y, h, color);
  }
  return 0;
}

/**
 *
 */
alt_u32 drawCircleHelper(alt_16 x0, alt_16 y0, alt_16 r, alt_u8 cornername, alt_u32 color)
{
  alt_16 f     = 1 - r;
  alt_16 ddF_x = 1;
  alt_16 ddF_y = -2 * r;
  alt_16 x     = 0;
  alt_16 y     = r;

  while (x<y) {
    if (f >= 0) {
      y--;
      ddF_y += 2;
      f     += ddF_y;
    }
    x++;
    ddF_x += 2;
    f     += ddF_x;
    if (cornername & 0x4) {
      writePixel(x0 + x, y0 + y, color);
      writePixel(x0 + y, y0 + x, color);
    }
    if (cornername & 0x2) {
      writePixel(x0 + x, y0 - y, color);
      writePixel(x0 + y, y0 - x, color);
    }
    if (cornername & 0x8) {
      writePixel(x0 - y, y0 + x, color);
      writePixel(x0 - x, y0 + y, color);
    }
    if (cornername & 0x1) {
      writePixel(x0 - y, y0 - x, color);
      writePixel(x0 - x, y0 - y, color);
    }
  }
  return 0;
}

/**
 * Draw a circle outline
 */
alt_u32 drawCircle(alt_u16 x0, alt_u16 y0, alt_u16 r, alt_u32 color)
{
  alt_16 f     =  1 - r;
  alt_16 ddF_x =  1;
  alt_16 ddF_y = -2 * r;
  alt_16 x     =  0;
  alt_16 y     =  r;

  writePixel(x0  , y0+r, color);
  writePixel(x0  , y0-r, color);
  writePixel(x0+r, y0  , color);
  writePixel(x0-r, y0  , color);

  while(x<y){
    if(f>=0){
      y--;
      ddF_y += 2;
      f += ddF_y;
    }
    x++;
    ddF_x += 2;
    f += ddF_x;

    writePixel(x0 + x, y0 + y, color);
    writePixel(x0 - x, y0 + y, color);
    writePixel(x0 + x, y0 - y, color);
    writePixel(x0 - x, y0 - y, color);
    writePixel(x0 + y, y0 + x, color);
    writePixel(x0 - y, y0 + x, color);
    writePixel(x0 + y, y0 - x, color);
    writePixel(x0 - y, y0 - x, color);
  }
  return 0;
}

/**
 * Used to do circles and roundrects
 *
 */
alt_u32 fillCircleHelper(alt_u16 x0, alt_u16 y0, alt_u16 r, alt_u8 cornername, alt_u16 delta, alt_u32 color)
{
  alt_16 f     =  1 - r;
  alt_16 ddF_x =  1;
  alt_16 ddF_y = -2 * r;
  alt_16 x     =  0;
  alt_16 y     =  r;

  while (x<y) {
    if (f >= 0) {
      y--;
      ddF_y += 2;
      f     += ddF_y;
    }
    x++;
    ddF_x += 2;
    f     += ddF_x;

    if (cornername & 0x1) {
      writeVLine(x0+x, y0-y, 2*y+1+delta, color);
      writeVLine(x0+y, y0-x, 2*x+1+delta, color);
    }
    if (cornername & 0x2) {
      writeVLine(x0-x, y0-y, 2*y+1+delta, color);
      writeVLine(x0-y, y0-x, 2*x+1+delta, color);
    }
  }
  return 0;
}

/**
 */
alt_u32 fillCircle(alt_u16 x0, alt_u16 y0, alt_u16 r, alt_u32 color)
{
  writeVLine(x0, y0-r, 2*r+1, color);
  fillCircleHelper(x0, y0, r, 3, 0, color);
  return 0;
}

/**
 * Draw a rounded rectangle
 */
alt_u32 drawRoundRect(alt_u16 x, alt_u16 y, alt_u16 w,
  alt_u16 h, alt_u16 r, alt_u32 color)
{
  // smarter version
  writeHLine(x+r  , y    , w-2*r, color); // Top
  writeHLine(x+r  , y+h-1, w-2*r, color); // Bottom
  writeVLine(x    , y+r  , h-2*r, color); // Left
  writeVLine(x+w-1, y+r  , h-2*r, color); // Right
  // draw four corners
  drawCircleHelper(x+r    , y+r    , r, 1, color);
  drawCircleHelper(x+w-r-1, y+r    , r, 2, color);
  drawCircleHelper(x+w-r-1, y+h-r-1, r, 4, color);
  drawCircleHelper(x+r    , y+h-r-1, r, 8, color);
  return 0;
}

/**
 * Fill a rounded rectangle
 */
alt_u32 fillRoundRect(alt_u16 x, alt_u16 y, alt_u16 w,
        alt_u16 h, alt_u16 r, alt_u32 color)
{
  // smarter version
  fillRect(x+r, y, w-2*r, h, color);

  // draw four corners
  fillCircleHelper(x+w-r-1, y+r, r, 1, h-2*r-1, color);
  fillCircleHelper(x+r    , y+r, r, 2, h-2*r-1, color);
  return 0;
}

#if defined(GFX_FONTS) && (GFX_FONTS == 1)

// TEXT- AND CHARACTER-HANDLING FUNCTIONS ----------------------------------

/**
 * Draw a character
 */
alt_u32 setCursor(alt_u32 x, alt_u32 y)
{
  gfxGc->cursor_y=y;
  gfxGc->cursor_x=x;
  return 0;
}

alt_u32 setTextSize(alt_u16 size) {
  gfxGc->size=size;
}

alt_u32 setColor(alt_u32 color) {
  gfxGc->color=(gfxGc->color&0xff000000)|(color&0xffffff);
}

alt_u32 setAlpha(alt_u8 alpha) {
  gfxGc->color=(gfxGc->color&0xffffff)|((alt_u32)alpha<<24);
}

/**
 * Draw a character
 */
alt_u32 drawCharAtCursor( alt_u8 c)
{
  if(c=='\n') {
    gfxGc->cursor_y+=gfxGc->size*gfxFont->yAdvance;
    return 1;
  } else if (c=='\r') {
    gfxGc->cursor_x=0;
    return 1;
  } else {
    gfxGc->cursor_x += drawChar(gfxGc->cursor_x,gfxGc->cursor_y,gfxGc->color,gfxGc->size, c);
    return 1;
  }
}

/**
 * Draw a character
 */
alt_u32 drawChar(alt_u16 x, alt_u16 y, alt_u32 color, alt_u8 size, alt_u8 c)
{
  // Custom font

  // Character is assumed previously filtered by write() to eliminate
  // newlines, returns, non-printable characters, etc.  Calling
  // drawChar() directly with 'bad' characters of font may cause mayhem!

  c -= gfxFont->first;
  GFXglyph *glyph  = &(gfxFont->glyph[c]);
  alt_u8  *bitmap = gfxFont->bitmap;
  alt_u16  bo = glyph->bitmapOffset;
  alt_u8   w  = glyph->width;
  alt_u8   h  = glyph->height;
  alt_8    xo = glyph->xOffset;
  alt_8    yo = glyph->yOffset;
  alt_u8   xx, yy, bits = 0, bit = 0;
  alt_16   xo16 = 0, yo16 = 0;

  if(size > 1){
    xo16 = xo;
    yo16 = yo;
  }

  // Todo: Add character clipping here

  // NOTE: THERE IS NO 'BACKGROUND' COLOR OPTION ON CUSTOM FONTS.
  // THIS IS ON PURPOSE AND BY DESIGN.  The background color feature
  // has typically been used with the 'classic' font to overwrite old
  // screen contents with new data.  This ONLY works because the
  // characters are a uniform size; it's not a sensible thing to do with
  // proportionally-spaced fonts with glyphs of varying sizes (and that
  // may overlap).  To replace previously-drawn text when using a custom
  // font, use the getTextBounds() function to determine the smallest
  // rectangle encompassing a string, erase the area with fillRect(),
  // then draw new text.  This WILL infortunately 'blink' the text, but
  // is unavoidable.  Drawing 'background' pixels will NOT fix this,
  // only creates a new set of problems.  Have an idea to work around
  // this (a canvas object type for MCUs that can afford the RAM and
  // displays supporting setAddrWindow() and pushColors()), but haven't
  // implemented this yet.


  for(yy=0; yy<h; yy++) {
    for(xx=0; xx<w; xx++) {
      if(!(bit++ & 7)) {
        bits = bitmap[bo++];
      }
      if(bits & 0x80) {
        if(size == 1) {
          writePixel(x+xo+xx, y+yo+yy, color);
        } else {
          fillRect(x+(xo16+xx)*size, y+(yo16+yy)*size, size, size, color);
        }
      }
      bits <<= 1;
    }
  }
  return glyph->xAdvance * size;
}

/**
 *
 */
alt_u32 drawTxt(alt_u16 x, alt_u16 y, alt_u32 color, alt_u8* txt)
{
  int size;
  int i;

  size = 0;
  for(i=0; txt[i]; i++){
    size += drawChar(x+size, y, color, 1, txt[i]);
  }

  return size;
}

alt_u32 setFont(alt_u32 num)
{
#ifdef GFX_NUM_FONTS
  if (num<GFX_NUM_FONTS) {
    gfxFont = gfxFontRepo[num];
    return 0;
  }
#endif
  return -1;
}

#endif /* defined(GFX_FONTS) && (GFX_FONTS == 1) */

/**
 *
 */
alt_u32 drawBmp(GFXbmp* bmp, alt_u16 x, alt_u16 y, alt_u32 color)
{
  int xpos = x;
  int i;
  int j;
  alt_u16 tmp;

  for(i=0; i<bmp->size; i++) {
    tmp = bmp->bmp[i];
    for(j=0; j<16; j++){
      if(tmp & 0x8000) {
        writePixel(xpos, y, color);
      }
      tmp <<= 1;
      xpos++;
      if(xpos == x+bmp->width) {
        xpos = x;
        y++;
      }
    }
  }
  return 0;
}

#endif /* defined(GFX_MODULE) && (GFX_MODULE == 1) */
